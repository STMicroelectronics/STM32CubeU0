# file: LCD_Blink_Frequency.ioc
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Mcu.Family=STM32U0
Mcu.Name=STM32U083MCTx
Mcu.Package=LQFP80
NVIC.PriorityGroup=NVIC_PRIORITYGROUP_2
ProjectManager.HeapSize=0x200
ProjectManager.StackSize=0x400
ProjectManager.TargetToolchain=EWARM V9.20
RCC.ADCFreq_Value=48000000
RCC.AHBFreq_Value=48000000
RCC.CortexFreq_Value=48000000
RCC.HCLKFreq_Value=48000000
RCC.HSE_VALUE=4000000
RCC.HSI48_VALUE=48000000
RCC.HSI_VALUE=16000000
RCC.LSE_VALUE=32768
RCC.MSIClockRangeVal=RCC_MSIRANGE_11
RCC.MSI_VALUE=48000000
RCC.PLLM=RCC_PLLM_DIV8
RCC.PLLN=8
RCC.PLLSourceVirtual=RCC_PLLSOURCE_MSI
RCC.SYSCLKFreq_VALUE=48000000
RCC.SYSCLKSource=RCC_SYSCLKSOURCE_MSI
RCC.USBFreq_Value=48000000
RCC.VCOOutputFreq_Value=48000000
VP_PWR_VS_SECSignals.Mode=Security/Privilege
board=custom

// file: Src/main.c
/* USER CODE BEGIN Header */
/**
  ******************************************************************************
  * @file    LCD/LCD_Blink_Frequency/Src/main.c
  * @author  MCD Application Team
  * @brief   This example describes how to configure and use GPIOs through
  *          the STM32U0xx HAL API.
  ******************************************************************************
  * @attention
  *
  * Copyright (c) 2023 STMicroelectronics.
  * All rights reserved.
  *
  * This software is licensed under terms that can be found in the LICENSE file
  * in the root directory of this software component.
  * If no LICENSE file comes with this software, it is provided AS-IS.
  *
  ******************************************************************************
  */
/* USER CODE END Header */
#include "main.h"

/* USER CODE BEGIN PTD */
#define MAX_BLINKLING_LEVEL 7
/* USER CODE END PTD */

/* USER CODE BEGIN PV */
uint32_t BlinkCounter = 0;

uint32_t BlinkTable_Val[MAX_BLINKLING_LEVEL] =
{
  LCD_BLINKFREQUENCY_DIV16,
  LCD_BLINKFREQUENCY_DIV32,
  LCD_BLINKFREQUENCY_DIV64,
  LCD_BLINKFREQUENCY_DIV128,
  LCD_BLINKFREQUENCY_DIV256,
  LCD_BLINKFREQUENCY_DIV512,
  LCD_BLINKFREQUENCY_DIV1024
};

uint8_t *BlinkTable_Msg[MAX_BLINKLING_LEVEL] =
{
  (uint8_t *)"BK0016",
  (uint8_t *)"BK0032",
  (uint8_t *)"BK0064",
  (uint8_t *)"BK0128",
  (uint8_t *)"BK0256",
  (uint8_t *)"BK0512",
  (uint8_t *)"BK1024"
};
/* USER CODE END PV */

void SystemClock_Config(void);

int main(void)
{

  /* USER CODE BEGIN 1 */
  /* STM32U0xx HAL library initialization:
       - Configure the Flash prefetch
       - Systick timer is configured by default as source of time base, but user
         can eventually implement his proper time base source (a general purpose
         timer for example or other time source), keeping in mind that Time base
         duration should be kept 1ms since PPP_TIMEOUT_VALUEs are defined and
         handled in milliseconds basis.
       - Set NVIC Group Priority to 4
       - Low Level Initialization
     */
  /* USER CODE END 1 */

  /* MCU Configuration--------------------------------------------------------*/

  /* Reset of all peripherals, Initializes the Flash interface and the Systick. */
  HAL_Init();

  /* Configure the system clock */
  SystemClock_Config();

  /* Initialize all configured peripherals */
  /* USER CODE BEGIN 2 */

  /* Configure the Joystick Sel push-button */
  BSP_PB_Init(BUTTON_USER, BUTTON_MODE_EXTI);
  /* Initialize LED5 */
  BSP_LED_Init(LED5);

  /* LCD GLASS Initialization */
  BSP_LCD_GLASS_Init();

  /* Configure all LCD segments and Coms to blink at frequency LCDCLK/16 */
  BSP_LCD_GLASS_BlinkConfig(LCD_BLINKMODE_ALLSEG_ALLCOM, BlinkTable_Val[BlinkCounter]);

  /* Display the "BK0016" message on the LCD GLASS */
  BSP_LCD_GLASS_DisplayString((uint8_t*)BlinkTable_Msg[BlinkCounter]);
  /* USER CODE END 2 */

  /* Infinite loop */
  while (1)
  {

  }
}

void SystemClock_Config(void)
{
  RCC_OscInitTypeDef RCC_OscInitStruct = {0};
  RCC_ClkInitTypeDef RCC_ClkInitStruct = {0};

  /** Configure the main internal regulator output voltage
  */
  HAL_PWREx_ControlVoltageScaling(PWR_REGULATOR_VOLTAGE_SCALE1);

  /** Initializes the RCC Oscillators according to the specified parameters
  * in the RCC_OscInitTypeDef structure.
  */
  RCC_OscInitStruct.OscillatorType = RCC_OSCILLATORTYPE_MSI;
  RCC_OscInitStruct.MSIState = RCC_MSI_ON;
  RCC_OscInitStruct.MSICalibrationValue = RCC_MSICALIBRATION_DEFAULT;
  RCC_OscInitStruct.MSIClockRange = RCC_MSIRANGE_11;
  RCC_OscInitStruct.PLL.PLLState = RCC_PLL_NONE;
  if (HAL_RCC_OscConfig(&RCC_OscInitStruct) != HAL_OK)
  {
    Error_Handler();
  }

  /** Initializes the CPU, AHB and APB buses clocks
  */
  RCC_ClkInitStruct.ClockType = RCC_CLOCKTYPE_HCLK|RCC_CLOCKTYPE_SYSCLK
                              |RCC_CLOCKTYPE_PCLK1;
  RCC_ClkInitStruct.SYSCLKSource = RCC_SYSCLKSOURCE_MSI;
  RCC_ClkInitStruct.AHBCLKDivider = RCC_SYSCLK_DIV1;
  RCC_ClkInitStruct.APB1CLKDivider = RCC_HCLK_DIV1;

  if (HAL_RCC_ClockConfig(&RCC_ClkInitStruct, FLASH_LATENCY_1) != HAL_OK)
  {
    Error_Handler();
  }
}

/* USER CODE BEGIN 4 */
/**
  * @brief EXTI line detection callbacks
  * @param GPIO_Pin: Specifies the pins connected EXTI line
  * @retval None
  */
void HAL_GPIO_EXTI_Rising_Callback(uint16_t GPIO_Pin)
{
  if (GPIO_Pin == JOY1_SEL_PIN)
  {
    /* Clear The LCD GLASS */
    BSP_LCD_GLASS_Clear();
    BlinkCounter = (BlinkCounter+ 1) % MAX_BLINKLING_LEVEL;

    /* Configure all LCD segments and Coms to blink at frequency LCDCLK/BlinkTable_Val[BlinkCounter] */
    BSP_LCD_GLASS_BlinkConfig(LCD_BLINKMODE_ALLSEG_ALLCOM, BlinkTable_Val[BlinkCounter]);

    /* Display the BlinkTable_Msg[BlinkCounter] message on the LCD GLASS */
    BSP_LCD_GLASS_DisplayString((uint8_t*)BlinkTable_Msg[BlinkCounter]);

    /* Configure all LCD segments and Coms to blink at frequency LCDCLK/16 */
    BSP_LCD_GLASS_BlinkConfig(LCD_BLINKMODE_ALLSEG_ALLCOM, BlinkTable_Val[BlinkCounter]);

    /* Display the "BK0016" message on the LCD GLASS */
    BSP_LCD_GLASS_DisplayString((uint8_t*)BlinkTable_Msg[BlinkCounter]);

    /* Wait the button release */
    while(GPIO_PIN_SET == BSP_PB_GetState(BUTTON_USER));
    __HAL_GPIO_EXTI_CLEAR_IT(BUTTON_USER);
  }
}
/* USER CODE END 4 */

void Error_Handler(void)
{
  while(1)
  {
  }
}
